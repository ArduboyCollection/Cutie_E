/*
"Cutie E" is a video game created by Juice Lizard in 2017 (beginning 2018)
strongly inspired by the song and the video clip "You can sleep in my bed"
from the music band Vive la fête with Els Pynoo, Danny Mommens and Zelda von Trapp.

Press the correct buttons quickly to increase your score before that the music stops!
*/

#include <Arduboy2.h>
#include <ArduboyTones.h>

Arduboy2 arduboy;
ArduboyTones sound(arduboy.audio.enabled);

int fromZeroToFive = 8; // (button shown) 0:A, 1:B, 2:up, 3:down, 4:left, 5:right
int line = 6;
int column = 6;
int gamestate = 0; // 0:title screen, 1:game, 2:score
int buttonIPressed = 10; // (button pressed) 0:A, 1:B, 2:up, 3:down, 4:left, 5:right
int score = 0; // + 1 when you press the right button, - 1 when you press the wrong one
int framesCounter = 0;
bool begining = true; // when you start to play the quick time event
bool buttonStillPressed = false;
int untilScore = 0;
bool scoreIsDone = false;

// song when you play the quick time event
const uint16_t YouCanSleep[] PROGMEM = {
  NOTE_G3H,160, NOTE_REST,90, NOTE_G3H,160, NOTE_REST,90, NOTE_B3H,160, NOTE_REST,340, NOTE_G3H,250, NOTE_REST,100, NOTE_D3,250, NOTE_REST,150, NOTE_D3,250, NOTE_REST, 50, TONES_REPEAT
};
const uint16_t endOfSong[] PROGMEM = {
  NOTE_G3H,160, NOTE_REST,90, NOTE_G3H,160, NOTE_REST,90, NOTE_B3H,160, NOTE_REST,340, NOTE_D3,140, NOTE_REST,110, NOTE_F3H,140, NOTE_REST,110, NOTE_G3H,140, NOTE_REST,110, NOTE_B3H,140, TONES_END
};

const uint16_t scoreBip[] PROGMEM = {
NOTE_B3H, 30, TONES_END
};

// "cutie e" sprite (94x20 pixels, white)
const unsigned char title[] PROGMEM = {
  0x00, 0x00, 0x80, 0x40, 0x40, 0x40, 0x40, 0x40, 0xc0, 0xc0, 0x40, 0x40,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 0x00, 
};
// Els Pynoo sprite (128x64 pixels, white)
const unsigned char Els[] PROGMEM  = {
  0x00, 0x00, 0x00, 0x40, 0x00, 0x00, 0x00, 0x00, 0x10, 0x00, 0x00, 0x00,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 0x00,
};

// buttons sprites (20x20 pixels, black)
const unsigned char AInBlack[] PROGMEM = {
  0x00, 0x00, 0x00, 0x00, 0x00, 0x80, 0xc0, 0xe0, 0x70, 0x38, 0x38, 0x70,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 0x00, 
};

const unsigned char BInBlack[] PROGMEM = {
  0x00, 0x00, 0x00, 0x00, 0x00, 0xf0, 0xf0, 0x30, 0x30, 0x30, 0x30, 0x30,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 0x00, 
};

const unsigned char upInBlack[] PROGMEM = {
  0x00, 0x00, 0x00, 0x00, 0x00, 0x80, 0xc0, 0xe0, 0xf0, 0xf8, 0xf8, 0xf0,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 0x00, 
};

const unsigned char downInBlack[] PROGMEM = {
  0x00, 0x00, 0x00, 0x00, 0x00, 0x00, 0x00, 0x00, 0xf0, 0xf0, 0xf0, 0xf0,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 0x00, 
};

const unsigned char leftInBlack[] PROGMEM = {
  0x00, 0x00, 0x00, 0x00, 0x00, 0x80, 0xc0, 0xe0, 0xf0, 0xf0, 0x00, 0x00,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 0x00,
};

const unsigned char rightInBlack[] PROGMEM = {
  0x00, 0x00, 0x00, 0x00, 0x00, 0x00, 0x00, 0x00, 0x00, 0x00, 0xf0, 0xf0,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 0x00, 
};


// small heart sprite (22x18 pixels, white)
const unsigned char smallHeart[] PROGMEM = {
  0xf8, 0xfc, 0x6, 0x3, 0x3, 0x3, 0x6, 0x6, 0xc, 0x18, 0x30, 0x30,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 0x00, 
};

// big heart sprite (42x35 pixels, white)
const unsigned char bigHeart[] PROGMEM = {
0x00, 0x80, 0xe0, 0x70, 0x18, 0xc, 0xc, 0x6, 0x6, 0x6, 0x3, 0x3,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 0x00, 
};

// cross sprite if you press the wrong button (20x20 pixels, black)
const unsigned char cross[] PROGMEM = {
  0x00, 0x00, 0x8, 0x1c, 0x38, 0x70, 0xe0, 0xc0, 0x80, 0x00, 0x00, 0x80,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 0x00, 
};

// round sprite common to all the buttons (20x20 pixels, white)
const unsigned char whiteCircle[] PROGMEM = {
  0x80, 0xe0, 0xf8, 0xfc, 0xfc, 0xfe, 0xfe, 0xff, 0xff, 0xff, 0xff, 0xff,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 0x00, 
};

void setup() {
    arduboy.begin();
    arduboy.setFrameRate(60);
}

void loop() {
  if (!(arduboy.nextFrame()))
  return;
  arduboy.pollButtons();  
  arduboy.clear();

  switch(gamestate){

// title screen    
    case 0:
      arduboy.setCursor(28, 0);
      arduboy.print(F("Juice Lizard"));
      arduboy.setCursor(40, 10);
      arduboy.print(F("presents"));
      arduboy.drawBitmap(17, 23, title, 94, 20, WHITE);
      arduboy.setCursor(19, 56);
      arduboy.print(F("Press A to play"));

// goes to the quick time event when you press, then release the A button
      if(arduboy.justPressed(A_BUTTON)){
        gamestate = 1;
        randomSeed(millis());
        fromZeroToFive = random(6);
        while (arduboy.buttonsState()) {}
      }
      break;
      
// the quick time event (the game)      
    case 1:
// begin the music when you start to play    
      if(begining == true){
        sound.tones(YouCanSleep);
        begining = false;
      }
      if(framesCounter == 754) {
        sound.tones(endOfSong);
      }
// you have a limited number of frames to do the highest score you can
// game duration is approximately forteen seconds
      framesCounter = framesCounter + 1;

// background image with Els Pynoo      
      arduboy.drawBitmap(0, 0, Els, 128, 64, WHITE);

// check what button you just pressed
// - 1 if you press the wrong one      
      if(arduboy.justPressed(A_BUTTON)){
        buttonIPressed = 0;
        if(buttonIPressed != fromZeroToFive){
          score = score - 1;
        }
      }
      if(arduboy.justPressed(B_BUTTON)){
        buttonIPressed = 1;
        if(buttonIPressed != fromZeroToFive){
        score = score - 1;
        }
      }
      if(arduboy.justPressed(UP_BUTTON)){
        buttonIPressed = 2;
        if(buttonIPressed != fromZeroToFive){
          score = score - 1;
        }
      }
      if(arduboy.justPressed(DOWN_BUTTON)){
        buttonIPressed = 3;
        if(buttonIPressed != fromZeroToFive){
          score = score - 1;
        }
      }
      if(arduboy.justPressed(LEFT_BUTTON)){
        buttonIPressed = 4;
        if(buttonIPressed != fromZeroToFive){
          score = score - 1;
        }
      }
      if(arduboy.justPressed(RIGHT_BUTTON)){
        buttonIPressed = 5;
        if(buttonIPressed != fromZeroToFive){
          score = score - 1;
        }
      }

// when you just pressed the right button
// set up the new button to show
// add a point to your score     
      if(fromZeroToFive == buttonIPressed){
        fromZeroToFive = random(6);
        if(line != 102) {
          line = line + 32;
        } else {
          line = 6;
          if(column == 6) {
            column = column + 32;
          } else {
            column = 6;
          }
        }
        buttonIPressed = 10;
        score = score + 1;
        buttonStillPressed = true;
      }

// shows the various small pictures on the screen
// a white circle, six buttons and a cross      
      if(fromZeroToFive == 0) {
        arduboy.drawBitmap(line, column, whiteCircle, 20, 20, WHITE);
        if((arduboy.buttonsState() && (!(arduboy.pressed(A_BUTTON)))) && (buttonStillPressed == false)) {
          arduboy.drawBitmap(line, column, cross, 20, 20, BLACK);
        } else {
          arduboy.drawBitmap(line, column, AInBlack, 20, 20, BLACK);
          if(!(arduboy.buttonsState())) {         
            buttonStillPressed = false;
          }
        }  
      }
      
      if(fromZeroToFive == 1) {
        arduboy.drawBitmap(line, column, whiteCircle, 20, 20, WHITE);
        if((arduboy.buttonsState() && (!(arduboy.pressed(B_BUTTON)))) && (buttonStillPressed == false)) {
            arduboy.drawBitmap(line, column, cross, 20, 20, BLACK);
          } else {
            arduboy.drawBitmap(line, column, BInBlack, 20, 20, BLACK);
            if(!(arduboy.buttonsState())) {         
            buttonStillPressed = false;
          }
        }
      }
      
      if(fromZeroToFive == 2) {
        arduboy.drawBitmap(line, column, whiteCircle, 20, 20, WHITE);
        if((arduboy.buttonsState() && (!(arduboy.pressed(UP_BUTTON)))) && (buttonStillPressed == false)) {
            arduboy.drawBitmap(line, column, cross, 20, 20, BLACK);
          } else {
            arduboy.drawBitmap(line, column, upInBlack, 20, 20, BLACK);
            if(!(arduboy.buttonsState())) {         
            buttonStillPressed = false;
          }
        }
      }
  
      if(fromZeroToFive == 3) {
        arduboy.drawBitmap(line, column, whiteCircle, 20, 20, WHITE);
        if((arduboy.buttonsState() && (!(arduboy.pressed(DOWN_BUTTON)))) && (buttonStillPressed == false)) {
            arduboy.drawBitmap(line, column, cross, 20, 20, BLACK);
          } else {
            arduboy.drawBitmap(line, column, downInBlack, 20, 20, BLACK);
            if(!(arduboy.buttonsState())) {         
            buttonStillPressed = false;
          }
        }
      }
  
      if(fromZeroToFive == 4) {
        arduboy.drawBitmap(line, column, whiteCircle, 20, 20, WHITE);
        if((arduboy.buttonsState() && (!(arduboy.pressed(LEFT_BUTTON)))) && (buttonStillPressed == false)) {
            arduboy.drawBitmap(line, column, cross, 20, 20, BLACK);
          } else {
            arduboy.drawBitmap(line, column, leftInBlack, 20, 20, BLACK);
            if(!(arduboy.buttonsState())) {         
            buttonStillPressed = false;
          }
        }
      }
  
      if(fromZeroToFive == 5) {
        arduboy.drawBitmap(line, column, whiteCircle, 20, 20, WHITE);
        if((arduboy.buttonsState() && (!(arduboy.pressed(RIGHT_BUTTON)))) && (buttonStillPressed == false)) {
            arduboy.drawBitmap(line, column, cross, 20, 20, BLACK);
          } else {
            arduboy.drawBitmap(line, column, rightInBlack, 20, 20, BLACK);
            if(!(arduboy.buttonsState())) {         
            buttonStillPressed = false;
          }
        }
      }

// end the game when the time is over  
      if(framesCounter > 900){
        gamestate = 2;
        line = 6;
        column = 6;
        buttonIPressed = 10;
        fromZeroToFive = 8;
        framesCounter = 0;
//        arduboy.audio.off();
        begining = true;
      }
      break;

// game over (your score)  
    case 2:
// a number increases quickly until the score that you made
      if(untilScore < score) {
        if(untilScore < 10){
          arduboy.setCursor(59, 24);
        } else {
          arduboy.setCursor(53,24);
        }
        arduboy.setTextSize(2);
        arduboy.print(untilScore);
        arduboy.setTextSize(1);
        if(arduboy.everyXFrames(5)){
          untilScore = untilScore + 1;
          sound.tones(scoreBip);
        }
      } else {
// tells you politely to try again if your score is null or negative
        if(score < 1){
          arduboy.setCursor(4, 24);
          arduboy.setTextSize(2);
          arduboy.print(F("Try again!"));
          arduboy.setTextSize(1);
        } else {
// shows the final score you made
          if(score < 10){
            arduboy.setCursor(59, 24);
          } else {
            arduboy.setCursor(53, 24);
          }
          arduboy.setTextSize(2);
          arduboy.print(score);
          arduboy.setTextSize(1);
        }
        scoreIsDone = true;
      }

      if(scoreIsDone == true){
// put the score inside an heart if you played quite well
        if((score > 20) && (score < 26)){
          arduboy.drawBitmap(43, 16, bigHeart, 42, 35, WHITE);
        }
// shows two additional small hearts if you played very well
        if(score > 25){
          arduboy.drawBitmap(43, 16, bigHeart, 42, 35, WHITE);
          arduboy.drawBitmap(13, 23, smallHeart, 22, 18, WHITE);
          arduboy.drawBitmap(93, 23, smallHeart, 22, 18, WHITE);
        }
        
        if(framesCounter < 120) {
        framesCounter = framesCounter + 1;
        }

// press A to go back to title screen
        if(framesCounter > 100) {
          if(arduboy.justPressed(A_BUTTON)) {
            gamestate = 0;
            score = 0;
            framesCounter = 0;
            untilScore = 0;
            scoreIsDone = false;
          }
        }
      }
      break;
  }

  arduboy.display();

}
